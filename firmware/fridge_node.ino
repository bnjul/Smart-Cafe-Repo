/*
  =================================================================
   CAFE IOT SYSTEM - FRIDGE NODE (ESP32-S3)
  =================================================================
   Implements "Smart Refrigerator IoT Requirements" (v1 scope):
   - Door OPEN/CLOSED via a magnetic reed switch (40 ms debounce).
   - If the door stays open for 5 s, a spoken "Please close the
     refrigerator door." plays on a speaker, then repeats every 5 s
     until the door closes (closing stops playback immediately).
   - AC supply presence (ON / OFF / UNKNOWN) from an ISOLATED,
     certified AC-presence detector module that gives a 3.3 V-safe
     logic output. The state only changes after it has been stable
     for POWER_VALIDATE_MS, so brief disturbances are ignored.
   - Publishes to MQTT (Last Will, retained state, heartbeat).

   WHAT THIS DOES NOT DO (per the requirements document):
   - It does not prove the compressor is running or that the fridge
     is cooling - only that mains voltage is present at the point the
     detector is connected to.
   - If this ESP32 loses power or Wi-Fi it cannot report anything.
     The dashboard shows the supply state as UNKNOWN in that case
     (never "OFF"). Power the ESP32 from a SEPARATE supply from the
     one you are monitoring, otherwise it cannot report an outage.

   DESIGN NOTE - local logic is independent of the network:
   The door timer, voice warning and supply validation run in their
   own FreeRTOS tasks and never touch Wi-Fi/MQTT, so the spoken
   warning still works if the router or broker is down. Only the main
   loop() does networking, and a slow reconnect cannot delay a warning.

   !! MAINS SAFETY !!
   Never connect mains live/neutral to any ESP32 pin, breadboard, USB
   or non-isolated circuit. Use a certified, properly rated isolated
   AC-presence module with a documented low-voltage output, keep mains
   wiring in a suitable enclosure, and have a QUALIFIED ELECTRICIAN do
   all mains-side installation. This firmware only reads the module's
   low-voltage output pin.

   REQUIREMENTS
   - Board: "ESP32S3 Dev Module"   ESP32 Arduino core 3.x
     (uses the new ESP-IDF 5 I2S driver; core 2.x will not compile)
   - Libraries: PubSubClient, ArduinoJson (v6)  (I2S is built in)
   - voice_clip.h in this folder (generated by tools/wav_to_header.js;
     a ready-made one is included).

   WIRING (defaults - change the #defines below; verify YOUR board's
   pinout, avoid GPIO26-32 flash/PSRAM, 19/20 USB, 0/3/45/46 strapping,
   and 35-37 on octal-PSRAM boards)
   - Reed switch:   one leg -> GPIO4, other leg -> GND  (INPUT_PULLUP)
   - AC detector:   module logic OUT -> GPIO5, module GND -> ESP32 GND
                    (output must be 3.3 V-safe - check the datasheet)
   - MAX98357A I2S amplifier:  BCLK -> GPIO15, LRC -> GPIO16,
                    DIN -> GPIO17, VIN -> 5 V, GND -> GND,
                    SD left floating (mono mix), speaker on +/-
   - Power: ESP32 and amplifier from a regulated 5 V supply that is
     NOT the circuit being monitored (see note above).
  =================================================================
*/

#if __has_include("esp_arduino_version.h")
#include "esp_arduino_version.h"
#endif
#if defined(ESP_ARDUINO_VERSION_MAJOR) && (ESP_ARDUINO_VERSION_MAJOR < 3)
#error "fridge_node.ino needs the ESP32 Arduino core 3.x (Tools > Board > Boards Manager > esp32 by Espressif, version 3.0.0 or newer)."
#endif

#include <WiFi.h>
#include <PubSubClient.h>
#include <ArduinoJson.h>
#include "driver/i2s_std.h"
#include "voice_clip.h"   // defines VOICE_SAMPLE_RATE, voiceClip[], VOICE_CLIP_SAMPLES

// ====================== CONFIGURE THESE ======================



const char* WIFI_SSID     = "BathanX_2.4";
const char* WIFI_PASSWORD = "BathanX4444";
const char* MQTT_HOST = "192.168.1.77";
const int   MQTT_PORT = 1883;
const char* MQTT_USER = "";
const char* MQTT_PASS = "";
const char* DEVICE_ID = "fridge01";

// ---- Pins ----
#define REED_PIN          4
#define POWER_DETECT_PIN  5
#define I2S_BCLK_PIN      15
#define I2S_LRC_PIN       16
#define I2S_DOUT_PIN      17

// ---- Reed switch polarity ----
// Typical normally-open reed + INPUT_PULLUP + magnet on the closed
// door: the magnet closes the contact -> pin reads LOW -> door CLOSED.
// If your switch/magnet arrangement behaves the opposite way (e.g. a
// normally-closed contact), set this to false.
// ALWAYS verify with the Serial Monitor before installing.
const bool REED_LOW_MEANS_DOOR_CLOSED = true;

// ---- AC-presence detector output ----
// Which level does YOUR module output when AC voltage IS present?
// (see its datasheet - some modules are active-LOW)
const int  POWER_ACTIVE_LEVEL = HIGH;
// true only if the module output is open-collector / open-drain and
// needs the ESP32's internal pull-up.
const bool POWER_USE_PULLUP = false;
// Many cheap opto-isolated AC detectors do not give a steady level;
// they output a 50/60 Hz or 100/120 Hz PULSE TRAIN while mains is
// present. Set this to true for those: "present" then means "edges
// seen within the last POWER_PULSE_WINDOW_MS".
const bool POWER_SIGNAL_PULSED = false;
const uint32_t POWER_PULSE_WINDOW_MS = 100;

// ---- Timing (from the requirements document) ----
const uint32_t DOOR_DEBOUNCE_MS     = 40;     // reject contact bounce
const uint32_t DOOR_WARN_DELAY_MS   = 5000;   // door open this long -> first warning
const uint32_t DOOR_WARN_REPEAT_MS  = 5000;   // repeat while still open
const uint32_t POWER_VALIDATE_MS    = 1500;   // supply state must be stable this long
const uint32_t HEARTBEAT_IDLE_MS    = 10000;  // telemetry period, door closed
const uint32_t HEARTBEAT_OPEN_MS    = 5000;   // telemetry period, door open (duration counter)

// Speaker volume, 1-100 (% of the normalised clip). Lower it if the
// amplifier/speaker distorts or the 5 V supply sags.
const int VOLUME_PERCENT = 70;
// =============================================================

// ---- MQTT topics (from the requirements document) ----
const char* T_DOOR       = "cafe/fridge/door";          // OPEN | CLOSED | UNKNOWN   (retained)
const char* T_POWER      = "cafe/fridge/power";         // ON | OFF | UNKNOWN        (retained)
const char* T_AVAIL      = "cafe/fridge/availability";  // online | offline (LWT)    (retained)
const char* T_TELEMETRY  = "cafe/fridge/telemetry";     // combined JSON, heartbeat
const char* T_ALERT      = "cafe/fridge/alert";         // event strings, not retained

// ---- Shared state (control task writes, main loop reads) ----
enum : uint8_t { DOOR_UNKNOWN = 0, DOOR_CLOSED = 1, DOOR_OPEN = 2 };
enum : uint8_t { PWR_UNKNOWN = 0, PWR_ON = 1, PWR_OFF = 2 };
enum : uint8_t { ALERT_DOOR_OPEN_WARNING = 0, ALERT_SUPPLY_LOST = 1, ALERT_SUPPLY_RESTORED = 2 };

volatile uint8_t  g_door = DOOR_UNKNOWN;
volatile uint8_t  g_power = PWR_UNKNOWN;
volatile uint32_t g_doorOpenSince = 0;     // millis() when the stable OPEN began (0 = closed)
volatile bool     g_doorDirty = false;     // door state changed -> publish
volatile bool     g_powerDirty = false;    // power state changed -> publish
volatile uint32_t g_lastPowerEdgeMs = 0;   // pulsed-detector mode only
QueueHandle_t     g_alertQueue = nullptr;

// ---- Audio state ----
volatile bool g_playReq = false;
volatile bool g_abort = false;
volatile bool g_playing = false;
bool g_audioOk = false;
i2s_chan_handle_t g_tx = nullptr;
static const size_t AUDIO_CHUNK_FRAMES = 256;

// ---- Networking ----
WiFiClient netClient;
PubSubClient mqtt(netClient);
uint32_t lastWifiAttempt = 0;
uint32_t lastMqttAttempt = 0;
uint32_t lastTelemetry = 0;
bool forceTelemetry = true;
bool wasWifiUp = false;

const char* doorStr(uint8_t d) {
  return d == DOOR_OPEN ? "OPEN" : (d == DOOR_CLOSED ? "CLOSED" : "UNKNOWN");
}
const char* powerStr(uint8_t p) {
  return p == PWR_ON ? "ON" : (p == PWR_OFF ? "OFF" : "UNKNOWN");
}

// =====================================================================
//  AUDIO (I2S -> MAX98357A). Runs in its own task so playing a ~2 s
//  clip never blocks sensor reading or MQTT.
// =====================================================================
bool audioBegin() {
  i2s_chan_config_t chanCfg = I2S_CHANNEL_DEFAULT_CONFIG(I2S_NUM_AUTO, I2S_ROLE_MASTER);
  chanCfg.auto_clear = true;   // output silence (not a repeating buffer) when idle
  if (i2s_new_channel(&chanCfg, &g_tx, NULL) != ESP_OK) return false;

  i2s_std_config_t stdCfg = {
    .clk_cfg  = I2S_STD_CLK_DEFAULT_CONFIG(VOICE_SAMPLE_RATE),
    .slot_cfg = I2S_STD_PHILIPS_SLOT_DEFAULT_CONFIG(I2S_DATA_BIT_WIDTH_16BIT, I2S_SLOT_MODE_STEREO),
    .gpio_cfg = {
      .mclk = I2S_GPIO_UNUSED,
      .bclk = (gpio_num_t)I2S_BCLK_PIN,
      .ws   = (gpio_num_t)I2S_LRC_PIN,
      .dout = (gpio_num_t)I2S_DOUT_PIN,
      .din  = I2S_GPIO_UNUSED,
      .invert_flags = { .mclk_inv = false, .bclk_inv = false, .ws_inv = false },
    },
  };
  if (i2s_channel_init_std_mode(g_tx, &stdCfg) != ESP_OK) return false;
  return i2s_channel_enable(g_tx) == ESP_OK;
}

void audioTask(void*) {
  static int16_t stereo[AUDIO_CHUNK_FRAMES * 2];
  for (;;) {
    if (!g_playReq) { vTaskDelay(pdMS_TO_TICKS(10)); continue; }
    g_playReq = false;
    g_playing = true;

    size_t pos = 0;
    while (pos < VOICE_CLIP_SAMPLES && !g_abort) {
      size_t n = VOICE_CLIP_SAMPLES - pos;
      if (n > AUDIO_CHUNK_FRAMES) n = AUDIO_CHUNK_FRAMES;
      for (size_t i = 0; i < n; i++) {
        int16_t s = (int16_t)(((int32_t)voiceClip[pos + i] * VOLUME_PERCENT) / 100);
        stereo[2 * i] = s;       // mono clip -> both channels
        stereo[2 * i + 1] = s;
      }
      size_t written = 0;
      i2s_channel_write(g_tx, stereo, n * 4, &written, 1000);
      pos += n;
    }
    g_playing = false;
  }
}

// Ask the audio task to play the clip (ignored if one is already queued/playing).
void requestPlay() {
  if (!g_audioOk || g_playing || g_playReq) return;
  g_abort = false;
  g_playReq = true;
}
// Stop playback and cancel anything pending (door closed).
void abortPlay() {
  g_playReq = false;
  g_abort = true;
}

// =====================================================================
//  LOCAL CONTROL TASK: reed debounce, door timer, warning schedule,
//  supply validation. Never touches the network.
// =====================================================================
void IRAM_ATTR powerEdgeISR() { g_lastPowerEdgeMs = millis(); }

void queueAlert(uint8_t a) { xQueueSend(g_alertQueue, &a, 0); }

bool readPowerRaw(uint32_t now) {
  if (POWER_SIGNAL_PULSED) return (uint32_t)(now - g_lastPowerEdgeMs) < POWER_PULSE_WINDOW_MS;
  return digitalRead(POWER_DETECT_PIN) == POWER_ACTIVE_LEVEL;
}

void controlTask(void*) {
  // --- door debounce state ---
  int doorLast = digitalRead(REED_PIN);
  uint32_t doorChangeAt = millis();
  int doorStable = -1;                 // -1 = no stable reading yet
  // --- warning schedule ---
  uint32_t nextWarnAt = 0;
  bool alertSentThisOpen = false;
  // --- supply validation state ---
  bool pwrCandidate = readPowerRaw(millis());
  uint32_t pwrChangeAt = millis();

  for (;;) {
    uint32_t now = millis();

    // ---------- Door ----------
    int r = digitalRead(REED_PIN);
    if (r != doorLast) { doorLast = r; doorChangeAt = now; }
    if (doorLast != doorStable && (uint32_t)(now - doorChangeAt) >= DOOR_DEBOUNCE_MS) {
      doorStable = doorLast;
      bool closed = REED_LOW_MEANS_DOOR_CLOSED ? (doorStable == LOW) : (doorStable == HIGH);
      uint8_t newState = closed ? DOOR_CLOSED : DOOR_OPEN;
      if (newState != g_door) {
        g_door = newState;
        g_doorDirty = true;
        if (newState == DOOR_OPEN) {
          g_doorOpenSince = now;
          nextWarnAt = now + DOOR_WARN_DELAY_MS;
          alertSentThisOpen = false;
          Serial.println("[FRIDGE] Door OPEN");
        } else {
          g_doorOpenSince = 0;
          nextWarnAt = 0;
          abortPlay();                 // closing stops pending/active warnings and resets the timer
          Serial.println("[FRIDGE] Door CLOSED");
        }
      }
    }

    // ---------- Spoken warning schedule ----------
    if (g_door == DOOR_OPEN && nextWarnAt != 0 && (int32_t)(now - nextWarnAt) >= 0) {
      requestPlay();
      if (!alertSentThisOpen) {        // one alert event per open period, not one per repeat
        alertSentThisOpen = true;
        queueAlert(ALERT_DOOR_OPEN_WARNING);
      }
      nextWarnAt = now + DOOR_WARN_REPEAT_MS;
      Serial.println("[FRIDGE] Door open warning");
    }

    // ---------- Supply presence (validated) ----------
    bool rawPresent = readPowerRaw(now);
    if (rawPresent != pwrCandidate) { pwrCandidate = rawPresent; pwrChangeAt = now; }
    if ((uint32_t)(now - pwrChangeAt) >= POWER_VALIDATE_MS) {
      uint8_t newPwr = pwrCandidate ? PWR_ON : PWR_OFF;
      if (newPwr != g_power) {
        uint8_t prev = g_power;
        g_power = newPwr;
        g_powerDirty = true;
        Serial.printf("[FRIDGE] Supply %s\n", powerStr(newPwr));
        if (prev != PWR_UNKNOWN) {     // no alert for the very first reading after boot
          queueAlert(newPwr == PWR_OFF ? ALERT_SUPPLY_LOST : ALERT_SUPPLY_RESTORED);
        }
      }
    }

    vTaskDelay(pdMS_TO_TICKS(5));
  }
}

// =====================================================================
//  NETWORKING (main loop). Non-blocking apart from short connect tries.
// =====================================================================
void publishDoor()  { mqtt.publish(T_DOOR,  doorStr(g_door),   true); }
void publishPower() { mqtt.publish(T_POWER, powerStr(g_power), true); }

void publishTelemetry() {
  uint32_t secs = 0;
  uint32_t since = g_doorOpenSince;
  if (g_door == DOOR_OPEN && since != 0) secs = (millis() - since) / 1000;

  StaticJsonDocument<192> doc;
  doc["door"] = doorStr(g_door);
  doc["power"] = powerStr(g_power);
  doc["door_open_seconds"] = secs;
  doc["rssi"] = WiFi.RSSI();
  doc["uptime_s"] = millis() / 1000;
  char buf[192];
  serializeJson(doc, buf, sizeof(buf));
  mqtt.publish(T_TELEMETRY, buf, false);
}

void connectMqttOnce() {
  bool ok;
  if (strlen(MQTT_USER) > 0) {
    ok = mqtt.connect(DEVICE_ID, MQTT_USER, MQTT_PASS, T_AVAIL, 1, true, "offline");
  } else {
    ok = mqtt.connect(DEVICE_ID, T_AVAIL, 1, true, "offline");
  }
  if (ok) {
    Serial.println("[MQTT] Connected");
    mqtt.publish(T_AVAIL, "online", true);
    g_doorDirty = true;        // (re)publish the current state after every (re)connect
    g_powerDirty = true;
    forceTelemetry = true;
  } else {
    Serial.printf("[MQTT] Connect failed rc=%d, will retry\n", mqtt.state());
  }
}

void networkService() {
  uint32_t now = millis();
  bool wifiUp = (WiFi.status() == WL_CONNECTED);

  if (wifiUp != wasWifiUp) {
    wasWifiUp = wifiUp;
    if (wifiUp) { Serial.print("[WIFI] Connected, IP "); Serial.println(WiFi.localIP()); }
    else        { Serial.println("[WIFI] Lost - local door warnings keep working"); }
  }

  if (!wifiUp) {
    if (now - lastWifiAttempt > 20000) {
      lastWifiAttempt = now;
      WiFi.begin(WIFI_SSID, WIFI_PASSWORD);
    }
    return;
  }

  if (!mqtt.connected()) {
    if (now - lastMqttAttempt > 5000) {
      lastMqttAttempt = now;
      connectMqttOnce();
    }
    return;
  }

  mqtt.loop();

  // State changes: publish immediately. Clear the flag BEFORE reading the state
  // so a change that lands during the publish simply sets the flag again.
  if (g_doorDirty)  { g_doorDirty = false;  publishDoor();  forceTelemetry = true; }
  if (g_powerDirty) { g_powerDirty = false; publishPower(); forceTelemetry = true; }

  // Alert events
  uint8_t a;
  while (xQueueReceive(g_alertQueue, &a, 0) == pdTRUE) {
    const char* msg = (a == ALERT_DOOR_OPEN_WARNING) ? "DOOR_OPEN_WARNING"
                    : (a == ALERT_SUPPLY_LOST)       ? "SUPPLY_LOST"
                                                     : "SUPPLY_RESTORED";
    mqtt.publish(T_ALERT, msg, false);
    Serial.printf("[MQTT] Alert: %s\n", msg);
  }

  // Heartbeat / door-duration telemetry
  uint32_t interval = (g_door == DOOR_OPEN) ? HEARTBEAT_OPEN_MS : HEARTBEAT_IDLE_MS;
  if (forceTelemetry || now - lastTelemetry >= interval) {
    forceTelemetry = false;
    lastTelemetry = now;
    publishTelemetry();
  }
}

// =====================================================================
void setup() {
  Serial.begin(115200);
  delay(300);
  Serial.println("\n[FRIDGE] Booting fridge node");

  pinMode(REED_PIN, INPUT_PULLUP);
  pinMode(POWER_DETECT_PIN, POWER_USE_PULLUP ? INPUT_PULLUP : INPUT);
  if (POWER_SIGNAL_PULSED) {
    attachInterrupt(digitalPinToInterrupt(POWER_DETECT_PIN), powerEdgeISR, CHANGE);
  }

  g_alertQueue = xQueueCreate(8, sizeof(uint8_t));

  g_audioOk = audioBegin();
  if (g_audioOk) {
    xTaskCreatePinnedToCore(audioTask, "audio", 4096, NULL, 2, NULL, 0);
    Serial.println("[AUDIO] I2S ready");
  } else {
    Serial.println("[AUDIO] I2S init FAILED - warnings will be silent (alerts still sent)");
  }

  // Local logic starts before (and independently of) any networking.
  xTaskCreatePinnedToCore(controlTask, "control", 4096, NULL, 3, NULL, 1);

  WiFi.mode(WIFI_STA);
  WiFi.setAutoReconnect(true);
  WiFi.begin(WIFI_SSID, WIFI_PASSWORD);   // non-blocking: loop() handles the rest

  mqtt.setServer(MQTT_HOST, MQTT_PORT);
  mqtt.setBufferSize(256);
  mqtt.setKeepAlive(15);
  mqtt.setSocketTimeout(3);
}

void loop() {
  networkService();
  delay(5);
}
